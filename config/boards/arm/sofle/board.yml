## config/boards/arm/sofle/board.yml
```yaml
board:
  - name: sofle_left
    full_name: Sofle Left
    socs:
      - name: nrf52840
  - name: sofle_right
    full_name: Sofle Right
    socs:
      - name: nrf52840
```

## config/west.yml
```yaml
manifest:
  remotes:
    - name: zmkfirmware
      url-base: https://github.com/zmkfirmware
    - name: urob
      url-base: https://github.com/urob
    - name: prospector
      url-base: https://github.com/t-ogura
    - name: siddhantac
      url-base: https://github.com/siddhantac 

  projects:
    # ZMK Base Firmware
    - name: zmk
      remote: zmkfirmware
      revision: v0.3.0
      import: app/west.yml
    # ZMK-Unicode: For german unicode chars
    - name: zmk-unicode
      remote: urob
      revision: v0.3.0 # Must match the ZMK main
    # Prospector Dongle
    - name: prospector-zmk-module
      remote: prospector
      revision: v1.1.1
      path: modules/prospector-zmk-module
    # Araska Anim on right display
    - name: nice-view
      remote: siddhantac 
      revision: main 

  self:
    path: config
```
